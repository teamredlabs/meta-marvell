## conf/machine/include/armada37xx-base.inc
```bitbake
# Provides the Marvell Armada 37xx common settings

require conf/machine/include/arm/arch-arm64.inc

require conf/multilib.conf
MULTILIBS = "multilib:lib32"
DEFAULTTUNE_virtclass-multilib-lib32 = "armv8a-neon"

MACHINE_ENDIANNESS ?= "le"

DEFAULTTUNE_armada37xx ?= "${@bb.utils.contains("MACHINE_ENDIANNESS", "le", "aarch64", "aarch64_be", d)}"

MACHINEOVERRIDES =. "armada37xx:"

PREFERRED_PROVIDER_u-boot-script ??= "u-boot-script-marvell"

IMAGE_FSTYPES += "tar.bz2"

SERIAL_CONSOLE = "115200 ttyMV0"

PREFERRED_PROVIDER_virtual/kernel ??= "linux-marvell"
KERNEL_IMAGETYPE = "Image"

MACHINE_FEATURES = "ext2 ipsec nfs pci smbfs usbgadget usbhost vfat"
```

## conf/machine/include/armada38x-base.inc
```bitbake
# Provides the Marvell Armada 38x common settings

require conf/machine/include/tune-cortexa9.inc

MACHINE_ENDIANNESS ?= "le"

MACHINEOVERRIDES =. "${@bb.utils.contains("MACHINE_ENDIANNESS", "be", "armada38x-be", "armada38x-le", d)}:"

DEFAULTTUNE_armada38x-le ?= "armv7ahf-neon"
DEFAULTTUNE_armada38x-be ?= "armv7ahfb-neon"

MACHINEOVERRIDES =. "armada38x:"

PREFERRED_PROVIDER_u-boot ??= "u-boot-marvell"
PREFERRED_PROVIDER_virtual/bootloader ??= "u-boot-marvell"

PREFERRED_PROVIDER_u-boot-script ??= "u-boot-script-marvell"

# Packages essential for booting
MACHINE_ESSENTIAL_EXTRA_RDEPENDS += " \
    kernel-image \
    kernel-devicetree \
    u-boot-script \
"

IMAGE_FSTYPES += "tar.bz2 ext2 sdcard"
IMAGE_CLASSES += "image_types_marvell"

SERIAL_CONSOLE = "115200 ttyS0"

PREFERRED_PROVIDER_virtual/kernel ?= "linux-marvell"
KERNEL_IMAGETYPE = "zImage"

UBOOT_SUFFIX = "bin"
UBOOT_MACHINE = "armada_38x_config"

MACHINE_FEATURES = "ext2 ipsec nfs pci smbfs usbgadget usbhost vfat"
```

## conf/machine/include/armada70xx-base.inc
```bitbake
# Provides the Marvell Armada 70xx common settings

require conf/machine/include/arm/arch-arm64.inc

MACHINE_ENDIANNESS ?= "le"

DEFAULTTUNE_armada70xx ?= "${@bb.utils.contains("MACHINE_ENDIANNESS", "le", "aarch64", "aarch64_be", d)}"

MACHINEOVERRIDES =. "armada70xx:"

PREFERRED_PROVIDER_u-boot-script ??= "u-boot-script-marvell"

IMAGE_FSTYPES += "tar.bz2 wic.gz"

WKS_FILES_append = " armada70xx.wks"

# Install wic dependencies
IMAGE_DEPENDS_wic_append = " \
    dosfstools-native \
    mtools-native \
    ${@bb.utils.contains("MACHINE_FEATURES", "edk-efi", "edk-marvell", "", d)} \
"

IMAGE_BOOT_FILES = "\
    Image;${@bb.utils.contains("MACHINE_FEATURES", "edk-efi", "Linux.efi", "Image", d)}\
    ${@bb.utils.contains("MACHINE_FEATURES", "edk-efi", "startup.nsh", "", d)} \
"

SERIAL_CONSOLE = "115200 ttyS0"

PREFERRED_PROVIDER_virtual/kernel ??= "linux-marvell"
KERNEL_IMAGETYPE = "Image"

MACHINE_FEATURES = "ext2 ipsec nfs pci smbfs usbgadget usbhost vfat"

MACHINE_FEATURES_BACKFILL_CONSIDERED += "${@bb.utils.contains("MACHINE_ENDIANNESS", "be", "qemu-usermode", "", d)}"
```

## conf/machine/include/marvell-armada37xx-base.inc
```bitbake
# Provides the Marvell Armada 37xx common settings

require conf/machine/include/arm/marvell-arch-arm64.inc

require conf/multilib.conf
MULTILIBS = "multilib:lib32"
DEFAULTTUNE_virtclass-multilib-lib32 = "armv8a-neon"

MACHINE_ENDIANNESS ?= "le"

DEFAULTTUNE_armada37xx ?= "${@bb.utils.contains("MACHINE_ENDIANNESS", "le", "aarch64", "aarch64_be", d)}"

MACHINEOVERRIDES =. "armada37xx:"

PREFERRED_PROVIDER_u-boot-script ??= "u-boot-script-marvell"

MACHINE_ESSENTIAL_EXTRA_RDEPENDS += " \
    kernel-image \
    kernel-devicetree \
"

IMAGE_FSTYPES += "tar.bz2"

IMAGE_BOOT_FILES = "\
    Image;${@bb.utils.contains("MACHINE_FEATURES", "edk-efi", "Linux.efi", "Image", d)}\
    ${@bb.utils.contains("MACHINE_FEATURES", "edk-efi", "startup.nsh", "", d)} \
"

SERIAL_CONSOLE = "115200 ttyMV0"

PREFERRED_PROVIDER_virtual/kernel ??= "linux-marvell"
KERNEL_IMAGETYPE = "Image"

MACHINE_FEATURES = "ext2 ipsec nfs pci smbfs usbgadget usbhost vfat"
```

## conf/machine/include/marvell-armada38x-base.inc
```bitbake
# Provides the Marvell Armada 38x common settings

require conf/machine/include/tune-cortexa9.inc

DEFAULTTUNE_armada38x ??= "armv7ahf-neon"

MACHINEOVERRIDES =. "armada38x:"

PREFERRED_PROVIDER_u-boot ??= "u-boot-marvell"
PREFERRED_PROVIDER_virtual/bootloader ??= "u-boot-marvell"

PREFERRED_PROVIDER_u-boot-fw-utils ?= "u-boot-fw-utils-marvell"
PREFERRED_RPROVIDER_u-boot-fw-utils ?= "u-boot-fw-utils-marvell"

PREFERRED_PROVIDER_u-boot-script ??= "u-boot-script-marvell"

# Packages essential for booting
MACHINE_ESSENTIAL_EXTRA_RDEPENDS += " \
    kernel-image \
    kernel-devicetree \
    u-boot-script \
"

IMAGE_FSTYPES += "tar.bz2 ext2 wic.gz"

WKS_FILES_append = " armada38x.wks"

# Install wic dependencies
IMAGE_DEPENDS_wic_append = " \
    dosfstools-native \
    mtools-native \
    ${@bb.utils.contains("MACHINE_FEATURES", "edk-efi", "edk-marvell", "", d)} \
"

IMAGE_BOOT_FILES = "\
    Image;${@bb.utils.contains("MACHINE_FEATURES", "edk-efi", "Linux.efi", "Image", d)}\
    ${@bb.utils.contains("MACHINE_FEATURES", "edk-efi", "startup.nsh", "", d)} \
"

SERIAL_CONSOLE = "115200 ttyS0"

PREFERRED_PROVIDER_virtual/kernel ?= "linux-marvell"
KERNEL_IMAGETYPE = "zImage"

UBOOT_SUFFIX = "bin"
UBOOT_MACHINE = "armada_38x_config"

WKS_FILES_append_armada38x = " armada38x.wks"
IMAGE_DEPENDS_wic_append_armada38x = " virtual/bootloader"

MACHINE_FEATURES = "ext2 ipsec nfs pci smbfs usbgadget usbhost vfat"
```

## conf/machine/include/meta-armada38x.inc
```bitbake
MACHINEOVERRIDES =. "armada38x:"

# Kernel modules are recommended, but not required for the machine to boot
MACHINE_EXTRA_RRECOMMENDS += "kernel-modules"

# boot.scr, DTB, and uImage are required for booting
MACHINE_ESSENTIAL_EXTRA_RDEPENDS += "kernel-image kernel-devicetree u-boot-script-marvell"

# Build U-Boot as part of a final image, even though it does not affect the RFS
EXTRA_IMAGEDEPENDS += "u-boot"

DEFAULTTUNE ?= "cortexa9hf-neon"
require conf/machine/include/tune-cortexa9.inc

IMAGE_FSTYPES += "tar.bz2 ext2 sdcard"
IMAGE_CLASSES += "image_types_marvell"

SERIAL_CONSOLE = "115200 ttyS0"

PREFERRED_PROVIDER_virtual/kernel ?= "linux-yocto-custom"
KERNEL_IMAGETYPE = "zImage"

PREFERRED_PROVIDER_u-boot = "u-boot-marvell"
UBOOT_SUFFIX = "bin"
UBOOT_MACHINE = "armada_38x_config"

PREFERRED_PROVIDER_jpeg = "libjpeg-turbo"
PREFERRED_PROVIDER_jpeg-native = "libjpeg-turbo-native"

MACHINE_FEATURES = "ext2 ipsec nfs pci smbfs usbgadget usbhost vfat"
```

## scripts/lib/wic/canned-wks/armada38x.wks
```
# short-description: Create SD card image with a boot partition
# long-description:
# Create an image that can be written onto a SD card using dd for use with armada38x machines.
#
part u-boot --source rawcopy --sourceparams="file=u-boot.mmc" --ondisk mmcblk --no-table --align 0
part /boot --source bootimg-partition --ondisk mmcblk --fstype=ext4 --label boot --active --align 4096 --size 8M --extra-space 0
part / --source rootfs --ondisk mmcblk --fstype=ext4 --label root --align 4096
```

## scripts/lib/wic/canned-wks/armada70xx.wks
```
part /boot --source bootimg-partition --ondisk mmcblk --fstype=vfat --label boot --active --align 4096 --size 20M --extra-space 0
part / --source rootfs --ondisk mmcblk --fstype=ext4 --label root --align 4096
```
