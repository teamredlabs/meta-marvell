## conf/layer.conf
```bitbake
# We have a conf and classes directory, add to BBPATH
BBPATH .= ":${LAYERDIR}"

# We have a recipes-* directories, add to BBFILES
BBFILES += "${LAYERDIR}/recipes-*/*/*.bb \
	${LAYERDIR}/recipes-*/*/*.bbappend \
	${LAYERDIR}/classes/*.bbclass \
"

BBFILE_COLLECTIONS += "armada38x"
BBFILE_PATTERN_armada38x = "^${LAYERDIR}/"
BBFILE_PRIORITY_armada38x = "7"

LAYERDEPENDS_armada38x = "core openembedded-layer networking-layer filesystems-layer"
```

## conf/machine/cb-88f3720-ddr3-espressobin.conf
```bitbake
#@TYPE: Machine
#@NAME: Marvell ESPRESSOBin community board (little-endian)
#@SOC: ARMADA 3720
#@DESCRIPTION: Machine configuration for Marvel ESPRESSOBin community board (little-endian)

require conf/machine/include/marvell-armada37xx-base.inc

PREFERRED_PROVIDER_virtual/kernel ?= "linux-marvell"

KERNEL_DEVICETREE = "marvell/armada-3720-community.dtb"

PREFERRED_PROVIDER_virtual/bootloader ?= "u-boot-marvell"
PREFERRED_PROVIDER_u-boot ?= "u-boot-marvell"

PREFERRED_PROVIDER_u-boot-fw-utils ?= "u-boot-fw-utils-marvell"
PREFERRED_RPROVIDER_u-boot-fw-utils ?= "u-boot-fw-utils-marvell"

UBOOT_MACHINE = "mvebu_espressobin-88f3720_defconfig"
UBOOT_DEVICE_TREE = "armada-3720-espressobin"
ARM_TRUSTED_FIRMWARE_PLATFORM = "a3700"

MACHINE_EXTRA_RRECOMMENDS += "kernel-modules"

IMAGE_BOOT_FILES_append = " \
    Image-armada-3720-community.dtb;fdt.dtb \
"
```

## conf/machine/cb-88f8040-mcbin.conf
```bitbake
#@TYPE: Machine
#@NAME: SolidRun MACCHIATOBin community board (little-endian)
#@SOC: ARMADA 8040
#@DESCRIPTION: Machine configuration for SolidRun MACCHIATOBin community board (little-endian)

require conf/machine/include/armada80xx-base.inc

PREFERRED_PROVIDER_virtual/kernel ?= "linux-marvell"

KERNEL_DEVICETREE = " \
    marvell/armada-8040-mcbin.dtb \
"

KERNEL_IMAGETYPE = "Image"

PREFERRED_PROVIDER_virtual/bootloader = "u-boot-marvell"
PREFERRED_PROVIDER_u-boot = "u-boot-marvell"

UBOOT_MACHINE = "mvebu_mcbin-88f8040_defconfig"
UBOOT_DEVICE_TREE = "armada-8040-mcbin"
ARM_TRUSTED_FIRMWARE_PLATFORM = "a80x0_cust"
EDK_PLATFORM = "Armada80x0"

#MACHINE_FEATURES += "edk-efi"

MACHINE_EXTRA_RRECOMMENDS += "kernel-modules"

IMAGE_BOOT_FILES_append = " \
    Image-armada-8040-mcbin.dtb;fdt.dtb \
"
```

## conf/machine/clearfog.conf
```bitbake
#@TYPE: Machine
#@NAME: SolidRun ClearFog
#@SOC: Armada 38x
#@DESCRIPTION: Machine configuration for SolidRun ClearFog

require conf/machine/include/marvell-armada38x-base.inc

KERNEL_DEVICETREE = "armada-388-clearfog.dtb"

UBOOT_MARVELL_MACHINE = "armada_38x_clearfog"
UBOOT_SUFFIX = "mmc"

MACHINE_EXTRA_RRECOMMENDS += "kernel-modules"

IMAGE_BOOT_FILES = "zImage zImage-armada-388-clearfog.dtb;armada-388-clearfog.dtb boot.scr"

WKS_FILES = "clearfog.wks"
```

## conf/machine/db-88f3720-ddr3-modular.conf
```bitbake
#@TYPE: Machine
#@NAME: Marvell DB-88F3720-DDR3-Modular Development board (little-endian)
#@SOC: ARMADA 3720
#@DESCRIPTION: Machine configuration for Marvel DB-88F3720-DDR3-Modular Development board (little-endian)

require conf/machine/include/armada37xx-base.inc

PREFERRED_PROVIDER_virtual/kernel ?= "linux-marvell"

KERNEL_DEVICETREE = " \
    marvell/armada-3720-db.dtb \
    marvell/armada-3720-db-B.dtb \
    marvell/armada-3720-db-C.dtb \
    marvell/armada-3720-community.dtb \
"

KERNEL_IMAGETYPE = "Image"

PREFERRED_PROVIDER_virtual/bootloader ?= "u-boot-marvell"
PREFERRED_PROVIDER_u-boot ?= "u-boot-marvell"

UBOOT_MACHINE = "mvebu_db-88f3720_defconfig"
UBOOT_DEVICE_TREE = "armada-3720-db"
ARM_TRUSTED_FIRMWARE_PLATFORM = "a3700"

MACHINE_EXTRA_RRECOMMENDS += "kernel-modules"
```

## conf/machine/db-88f6820-amc.conf
```bitbake
#@TYPE: Machine
#@NAME: Marvell 88F6820-AMC Development Board
#@SOC: Armada 38x
#@DESCRIPTION: Machine configuration for Marvell 88F6820-AMC Development Board

require conf/machine/include/marvell-armada38x-base.inc

KERNEL_DEVICETREE = "armada-385-amc.dtb"

UBOOT_MARVELL_MACHINE = "armada_38x"

MACHINE_EXTRA_RRECOMMENDS += "kernel-modules"

IMAGE_BOOT_FILES = "zImage zImage-armada-385-amc.dtb;armada-385-amc.dtb boot.scr"
```

## conf/machine/db-88f6820-gp.conf
```bitbake
#@TYPE: Machine
#@NAME: Marvell 88F6820-GP Development Board
#@SOC: Armada 38x
#@DESCRIPTION: Machine configuration for Marvell 88F6820-GP Development Board

require conf/machine/include/armada38x-base.inc

KERNEL_DEVICETREE = "armada-388-gp.dtb"

UBOOT_MARVELL_MACHINE = "armada_38x"

MACHINE_EXTRA_RRECOMMENDS += "kernel-modules"

IMAGE_BOOT_FILES = "zImage zImage-armada-388-db-gp.dtb;armada-388-db-gp.dtb boot.scr"
```

## conf/machine/db-88f7040-modular.conf
```bitbake
#@TYPE: Machine
#@NAME: Marvell DB-88F7040-Modular Development board (little-endian)
#@SOC: ARMADA 7040
#@DESCRIPTION: Machine configuration for Marvel DB-88F7040-Modular Development board (little-endian)

require conf/machine/include/armada70xx-base.inc

PREFERRED_PROVIDER_virtual/kernel ?= "linux-marvell"

KERNEL_DEVICETREE = " \
    marvell/armada-7040-db-A.dtb \
    marvell/armada-7040-db-B.dtb \
    marvell/armada-7040-db-C.dtb \
    marvell/armada-7040-db-D.dtb \
    marvell/armada-7040-db-E.dtb \
"

KERNEL_IMAGETYPE = "Image"

PREFERRED_PROVIDER_virtual/bootloader = "u-boot-marvell"
PREFERRED_PROVIDER_u-boot = "u-boot-marvell"

UBOOT_MACHINE = "mvebu_db_armada8k_defconfig"
UBOOT_DEVICE_TREE = "armada-7040-db"
ARM_TRUSTED_FIRMWARE_PLATFORM = "a70x0"
EDK_PLATFORM = "Armada70x0"

#MACHINE_FEATURES += "edk-efi"

MACHINE_EXTRA_RRECOMMENDS += "kernel-modules"

IMAGE_BOOT_FILES_append = " \
    Image-armada-7040-db-A.dtb;fdt.dtb \
"
```

## conf/machine/db-88f8040-modular.conf
```bitbake
#@TYPE: Machine
#@NAME: Marvell DB-88F8040-Modular Development board (little-endian)
#@SOC: ARMADA 8040
#@DESCRIPTION: Machine configuration for Marvel DB-88F8040-Modular Development board (little-endian)

require conf/machine/include/marvell-armada80xx-base.inc

PREFERRED_PROVIDER_virtual/kernel ?= "linux-marvell"

KERNEL_DEVICETREE = " \
    marvell/armada-8040-db.dtb \
    marvell/armada-8040-db-B.dtb \
    marvell/armada-8040-db-C.dtb \
    marvell/armada-8040-db-D.dtb \
    marvell/armada-8040-db-E.dtb \
    marvell/armada-8040-mcbin.dtb \
"

PREFERRED_PROVIDER_virtual/bootloader ?= "u-boot-marvell"
PREFERRED_PROVIDER_u-boot ?= "u-boot-marvell"

UBOOT_MACHINE = "mvebu_db_armada8k_defconfig"
UBOOT_DEVICE_TREE = "armada-8040-db"
ARM_TRUSTED_FIRMWARE_PLATFORM = "a80x0"
EDK_PLATFORM = "Armada80x0Db"

#MACHINE_FEATURES += "edk-efi"

MACHINE_EXTRA_RRECOMMENDS += "kernel-modules"

IMAGE_BOOT_FILES_append = " \
    Image-armada-8040-db.dtb;fdt.dtb \
"
```
